## config/boards/arm/LP88/Kconfig.board
```kconfig
# Copyright (c) 2020 The ZMK Contributors
# SPDX-License-Identifier: MIT

config BOARD_LP88
	bool "lp88"
	depends on SOC_NRF52840_QIAA
```

## config/boards/arm/choctkl/Kconfig.board
```kconfig
# Copyright (c) 2020 The ZMK Contributors
# SPDX-License-Identifier: MIT

config BOARD_CHOCTKL
	bool "choctkl"
	depends on SOC_NRF52840_QIAA
```
